## config/boards/shields/sheesh/Kconfig.defconfig
```kconfig
# Copyright (c) 2022 The ZMK Contributors
# SPDX-License-Identifier: MIT

if SHIELD_SHEESH_LEFT

config ZMK_KEYBOARD_NAME
    default "sheesh"

config ZMK_SPLIT_ROLE_CENTRAL
    default y

endif

if SHIELD_SHEESH_LEFT || SHIELD_SHEESH_RIGHT
config ZMK_SPLIT
    default y
endif
```

## config/boards/shields/sheesh/Kconfig.shield
```kconfig
# Copyright (c) 2022 The ZMK Contributors
# SPDX-License-Identifier: MIT

config SHIELD_SHEESH_LEFT
    def_bool $(shields_list_contains,sheesh_left)

config SHIELD_SHEESH_RIGHT
    def_bool $(shields_list_contains,sheesh_right)
```
